## config/boards/shields/mano/Kconfig.defconfig
```kconfig
if SHIELD_MANO_RIGHT

config ZMK_KEYBOARD_NAME
    default "Mano Board"

config ZMK_SPLIT_ROLE_CENTRAL
	default y
    
endif

if SHIELD_MANO_LEFT || SHIELD_MANO_RIGHT

config ZMK_SPLIT
    default y

endif


config CONFIG_ZMK_BACKLIGHT_AUTO_OFF_IDL
	default y
```

## config/boards/shields/mano/Kconfig.shield
```kconfig
config SHIELD_MANO_LEFT
    def_bool $(shields_list_contains,mano_left)

config SHIELD_MANO_RIGHT
    def_bool $(shields_list_contains,mano_right)  
```
