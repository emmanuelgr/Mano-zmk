/*
 * Lily58: 58 keys = the Corne's 42 + a number row, 2 middle keys and one extra
 * thumb key per side (L4 / R4). The layout itself lives in layout.dtsi.
 */

/* Combo key positions on the Lily58 (the Corne's + 12: one extra row on top). */
#define POS_S    26
#define POS_D    27
#define POS_F    28
#define POS_J    31
#define POS_K    32
#define POS_L    33
#define POS_SEMI 34

/* The 2 middle keys and L4 / R4 are unused (&none). No // comments in here. */
#define LAYOUT_LAYER(layer_node, layer_label, num_l, num_r, top_l, top_r, home_l, home_r, bot_l, bot_r, thumb_l, thumb_r) \
    layer_node {                              \
        display-name = layer_label;           \
        bindings = <                          \
            num_l   num_r                     \
            top_l   top_r                     \
            home_l  home_r                    \
            bot_l   &none &none   bot_r       \
            &none   thumb_l  thumb_r   &none  \
        >;                                    \
    };

#include "layout.dtsi"
