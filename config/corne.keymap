/*
 * Corne: 42 keys. The layout itself lives in layout.dtsi, shared with the Lily58.
 * This file only says where those keys sit on the Corne.
 */

/* Combo key positions on the Corne (rows of 12; the home row starts at 12). */
#define POS_S    14
#define POS_D    15
#define POS_F    16
#define POS_J    19
#define POS_K    20
#define POS_L    21
#define POS_SEMI 22

/* The Corne has no number row, so num_l and num_r are dropped. No // comments in here. */
#define LAYOUT_LAYER(layer_node, layer_label, num_l, num_r, top_l, top_r, home_l, home_r, bot_l, bot_r, thumb_l, thumb_r) \
    layer_node {                     \
        display-name = layer_label;  \
        bindings = <                 \
            top_l   top_r            \
            home_l  home_r           \
            bot_l   bot_r            \
            thumb_l thumb_r          \
        >;                           \
    };

#include "layout.dtsi"
