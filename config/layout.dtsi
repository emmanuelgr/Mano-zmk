/*
 * layout.dtsi: THE keyboard layout, shared by the Corne and the Lily58.
 * Change keys here only. corne.keymap and lily58.keymap just place these
 * rows on their own keys (the Corne skips the Lily58's number row).
 *
 * Each layer is written as rows of  <left half> , <right half> ,
 *   number row (Lily58 only), top, home, bottom: 6 keys per half
 *   thumbs: 3 per half, in the order L3 L2 L1 , R1 R2 R3
 *
 * Rules:
 *   - Keep exactly 6 keys per half-row and 3 per thumb half.
 *   - Never use // comments inside a #define (use slash-star comments).
 *   - MEDIA must stay the highest-numbered layer (it is a conditional layer).
 *   - After editing, refresh the cheat sheet: python3 scripts/layout_html.py
 */

#include <behaviors.dtsi>
#include <dt-bindings/zmk/keys.h>
#include <dt-bindings/zmk/bt.h>
#include <dt-bindings/zmk/pointing.h>

#define BASE    0
#define MODS_R  1   /* hold R1 (space) */
#define MODS_L  2   /* hold L1 (backspace) */
#define NAV     3   /* hold L2 */
#define MOUSE   4   /* hold R2 */
#define NUM_L   5   /* hold R3 */
#define NUM_R   6   /* hold L3 */
#define MEDIA   7   /* hold L1+L2 or R1+R2; must stay the highest layer */

/ {
    behaviors {
        /* C and , : tap = the letter, hold = F18. Karabiner (karabiner/karabiner.json)
         * turns F18 into the real Mac Fn/Globe key. tap-preferred: typing "ct" or ",a"
         * quickly still gives the letters; only a deliberate 200 ms hold gives Fn. */
        fnh: fn_hold_tap {
            compatible = "zmk,behavior-hold-tap";
            #binding-cells = <2>;
            flavor = "tap-preferred";
            tapping-term-ms = <200>;
            quick-tap-ms = <150>;
            bindings = <&kp>, <&kp>;
        };
    };

    combos {
        compatible = "zmk,combos";
        /* Base layer only, and only after a 150 ms pause, so fast typing never fires them. */
        combo_esc   { timeout-ms = <50>; require-prior-idle-ms = <150>; key-positions = <POS_S POS_D>;    bindings = <&kp ESC>;    layers = <BASE>; };
        combo_tab   { timeout-ms = <50>; require-prior-idle-ms = <150>; key-positions = <POS_D POS_F>;    bindings = <&kp TAB>;    layers = <BASE>; };
        combo_enter { timeout-ms = <50>; require-prior-idle-ms = <150>; key-positions = <POS_J POS_K>;    bindings = <&kp RETURN>; layers = <BASE>; };
        combo_bspc  { timeout-ms = <50>; require-prior-idle-ms = <150>; key-positions = <POS_K POS_L>;    bindings = <&kp BSPC>;   layers = <BASE>; };
        combo_del   { timeout-ms = <50>; require-prior-idle-ms = <150>; key-positions = <POS_L POS_SEMI>; bindings = <&kp DELETE>; layers = <BASE>; };
    };

    conditional_layers {
        compatible = "zmk,conditional-layers";
        media_left  { if-layers = <MODS_L NAV>;   then-layer = <MEDIA>; };   /* L1 + L2 */
        media_right { if-layers = <MODS_R MOUSE>; then-layer = <MEDIA>; };   /* R1 + R2 */
    };

    keymap {
        compatible = "zmk,keymap";

    /* Normal typing. Thumbs: L3 L2 L1 | R1 R2 R3. */
    LAYOUT_LAYER(default_layer, "Base",
        &kp MINUS  &kp N1  &kp N2  &kp N3      &kp N4  &kp N5 ,   &kp N6  &kp N7  &kp N8          &kp N9   &kp N0    &kp EQUAL  ,   /* number row (Lily58 only) */
        &kp LBKT   &kp Q   &kp W   &kp E       &kp R   &kp T  ,   &kp Y   &kp U   &kp I           &kp O    &kp P     &kp RBKT   ,   /* top */
        &kp TAB    &kp A   &kp S   &kp D       &kp F   &kp G  ,   &kp H   &kp J   &kp K           &kp L    &kp SEMI  &kp APOS   ,   /* home */
        &kp ESC    &kp Z   &kp X   &fnh F18 C  &kp V   &kp B  ,   &kp N   &kp M   &fnh F18 COMMA  &kp DOT  &kp FSLH  &kp RETURN ,   /* bottom */
                                   &mo NUM_R  &mo NAV  &lt MODS_L BSPC ,   &lt MODS_R SPACE  &mo MOUSE  &mo NUM_L
    )

    /* Hold R1 (space): mods under the right hand, the left hand types letters. */
    LAYOUT_LAYER(mods_r_layer, "R1 mods",
        &trans   &trans  &trans  &trans  &trans  &trans ,   &none     &none      &none     &kp C_VOL_DN  &kp C_VOL_UP  &kp C_MUTE ,   /* number row (Lily58 only) */
        &trans   &trans  &trans  &trans  &trans  &trans ,   &none     &none      &none     &none         &none         &none      ,   /* top */
        &kp TAB  &trans  &trans  &trans  &trans  &trans ,   &kp BSLH  &kp RGUI   &kp RALT  &kp RSHFT     &none         &none      ,   /* home */
        &kp ESC  &trans  &trans  &trans  &trans  &trans ,   &kp PIPE  &kp RCTRL  &kp BSPC  &kp DELETE    &none         &kp RETURN ,   /* bottom */
                                 &none  &none  &trans   ,   &trans  &trans  &none
    )

    /* Hold L1 (backspace): mods under the left hand, the right hand types letters. L1 + A = Caps Lock. */
    LAYOUT_LAYER(mods_l_layer, "L1 mods",
        &kp C_BRI_DEC  &kp C_BRI_INC  &none      &none     &none      &none     ,   &trans  &trans  &trans  &trans  &trans  &trans     ,   /* number row (Lily58 only) */
        &none          &none          &none      &none     &none      &none     ,   &trans  &trans  &trans  &trans  &trans  &trans     ,   /* top */
        &kp TAB        &kp CAPS       &kp LSHFT  &kp LALT  &kp LGUI   &kp GRAVE ,   &trans  &trans  &trans  &trans  &trans  &trans     ,   /* home */
        &kp ESC        &none          &none      &none     &kp LCTRL  &kp TILDE ,   &trans  &trans  &trans  &trans  &trans  &kp RETURN ,   /* bottom */
                                                 &none  &trans  &trans          ,   &trans  &none  &none
    )

    /* Hold L2: arrows on the right, mods under the left hand. */
    LAYOUT_LAYER(nav_layer, "L2 arrows",
        &none    &none  &none      &none     &none      &none ,   &none            &none       &none     &none       &none  &none      ,   /* number row (Lily58 only) */
        &none    &none  &none      &none     &none      &none ,   &kp PG_UP        &kp HOME    &kp UP    &kp END     &none  &none      ,   /* top */
        &kp TAB  &none  &kp LSHFT  &kp LALT  &kp LGUI   &none ,   &kp PG_DN        &kp LEFT    &kp DOWN  &kp RIGHT   &none  &none      ,   /* home */
        &kp ESC  &none  &none      &none     &kp LCTRL  &none ,   &kp PRINTSCREEN  &kp RETURN  &kp BSPC  &kp DELETE  &none  &kp RETURN ,   /* bottom */
                                   &none  &none  &trans       ,   &trans  &none  &none
    )

    /* Hold R2: mouse on the left, clicks on L1/L2/L3, mods under the right hand. */
    LAYOUT_LAYER(mouse_layer, "R2 mouse",
        &bootloader  &studio_unlock  &none           &none           &none            &none          ,   &bt BT_CLR  &bt BT_SEL 0  &bt BT_SEL 1  &bt BT_SEL 2  &none  &none      ,   /* number row (Lily58 only) */
        &none        &none           &msc SCRL_LEFT  &mmv MOVE_UP    &msc SCRL_RIGHT  &msc SCRL_UP   ,   &none       &none         &none         &none         &none  &none      ,   /* top */
        &kp TAB      &none           &mmv MOVE_LEFT  &mmv MOVE_DOWN  &mmv MOVE_RIGHT  &msc SCRL_DOWN ,   &none       &kp RGUI      &kp RALT      &kp RSHFT     &none  &none      ,   /* home */
        &kp ESC      &none           &none           &none           &none            &none          ,   &none       &kp RCTRL     &kp BSPC      &kp DELETE    &none  &kp RETURN ,   /* bottom */
                                                     &mkp MCLK  &mkp RCLK  &mkp LCLK                 ,   &trans  &trans  &none
    )

    /* Hold R3: numbers on the left home row, F1-F6 above, mods under the right hand. */
    LAYOUT_LAYER(num_l_layer, "R3 numbers",
        &trans     &trans  &trans  &trans  &trans  &trans ,   &trans    &trans     &trans    &trans     &trans  &trans ,   /* number row (Lily58 only) */
        &kp F1     &kp F2  &kp F3  &kp F4  &kp F5  &kp F6 ,   &none     &none      &none     &none      &none   &none  ,   /* top */
        &kp MINUS  &kp N1  &kp N2  &kp N3  &kp N4  &kp N5 ,   &kp BSLH  &kp RGUI   &kp RALT  &kp RSHFT  &none   &none  ,   /* home */
        &trans     &none   &none   &none   &none   &none  ,   &kp BSLH  &kp RCTRL  &none     &none      &none   &none  ,   /* bottom */
                                   &none  &none  &trans   ,   &trans  &none  &trans
    )

    /* Hold L3: numbers on the right home row, F7-F12 above, mods under the left hand. */
    LAYOUT_LAYER(num_r_layer, "L3 numbers",
        &trans  &trans  &trans     &trans    &trans     &trans    ,   &trans  &trans  &trans  &trans   &trans   &trans    ,   /* number row (Lily58 only) */
        &none   &none   &none      &none     &none      &none     ,   &kp F7  &kp F8  &kp F9  &kp F10  &kp F11  &kp F12   ,   /* top */
        &none   &none   &kp LSHFT  &kp LALT  &kp LGUI   &kp GRAVE ,   &kp N6  &kp N7  &kp N8  &kp N9   &kp N0   &kp EQUAL ,   /* home */
        &none   &none   &none      &none     &kp LCTRL  &kp TILDE ,   &none   &none   &none   &none    &none    &trans    ,   /* bottom */
                                   &trans  &none  &trans          ,   &trans  &none  &none
    )

    /* Hold L1+L2 or R1+R2: MacBook media row on the F1-F12 keys, Bluetooth, bootloader. */
    LAYOUT_LAYER(media_layer, "Media",
        &none         &none         &none         &none          &none  &none          ,   &none       &none     &none       &none       &none         &none        ,   /* number row (Lily58 only) */
        &kp C_BRI_DN  &kp C_BRI_UP  &kp LC(UP)    &kp LG(SPACE)  &none  &none          ,   &kp C_PREV  &kp C_PP  &kp C_NEXT  &kp C_MUTE  &kp C_VOL_DN  &kp C_VOL_UP ,   /* top */
        &bt BT_CLR    &bt BT_SEL 0  &bt BT_SEL 1  &bt BT_SEL 2   &none  &studio_unlock ,   &none       &none     &none       &none       &none         &none        ,   /* home */
        &bootloader   &sys_reset    &none         &none          &none  &none          ,   &none       &none     &none       &none       &sys_reset    &bootloader  ,   /* bottom */
                                                  &none  &trans  &trans                ,   &trans  &trans  &none
    )
    };
};
